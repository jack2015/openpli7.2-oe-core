## meta-dream/conf/machine/dm7020hd.conf
```bitbake
#@TYPE: Machine
#@NAME: Dreambox DM7020HD
#@DESCRIPTION: Machine configuration for the Dreambox DM7020HD

MACHINE_FEATURES += "modem kernelwifi externalwifi dvb-c blindscan-dvbc hdmicec ci dvd usbconsole colorlcd128 grautec"

MACHINE_ESSENTIAL_EXTRA_RDEPENDS += "dm-bootsplash"

require conf/machine/include/dreambox-hw-ecc.inc

DM7020NANDINC = "${@ '1024mb-2k' if d.getVar('DMTYPE') else '1024mb'}"

require conf/machine/include/dreambox-nand-${DM7020NANDINC}.inc

require conf/machine/include/dreambox-part-1024mb.inc
require conf/machine/include/dreambox-ubi.inc
require conf/machine/include/dreambox-mips32el.inc

PREFERRED_VERSION_linux-dreambox = "3.2"

CHIPSET = "bcm7405"

MACHINE_EXTRA_RRECOMMENDS += "dreambox-enigma2-config"
```

## meta-dream/conf/machine/dm800sev2.conf
```bitbake
#@TYPE: Machine
#@NAME: Dreambox DM800sev2
#@DESCRIPTION: Machine configuration for the Dreambox DM800sev2

MACHINE_FEATURES += "fan modem kernelwifi externalwifi dvb-c blindscan-dvbc hdmicec usbconsole colorlcd bwlcd96"

MACHINE_ESSENTIAL_EXTRA_RDEPENDS += "dm-bootsplash"

require conf/machine/include/dreambox-hw-ecc.inc
require conf/machine/include/dreambox-nand-1024mb-2k.inc
require conf/machine/include/dreambox-part-1024mb.inc
require conf/machine/include/dreambox-ubi.inc
require conf/machine/include/dreambox-mips32el.inc

PREFERRED_VERSION_linux-dreambox = "3.2"

CHIPSET = "bcm7405"
```

## meta-openpli/conf/layer.conf
```bitbake
# We have a conf and classes directory, append to BBPATH
BBPATH .= ":${LAYERDIR}"

# We have a recipes directory, add to BBFILES
BBFILES += "${LAYERDIR}/recipes-*/*/*.bb ${LAYERDIR}/recipes-*/*/*.bbappend"

BBFILE_COLLECTIONS += "openpli-layer"
BBFILE_PATTERN_openpli-layer := "^${LAYERDIR}/"
BBFILE_PRIORITY_openpli-layer = "7"

OPENPLI_BASE := '${@os.path.normpath("${LAYERDIR}/../")}'
# Prevent current directory creeping into sstate objects. Otherwise, building
# in another TOPDIR will cause recipes using this variable to be rebuilt.
OPENPLI_BASE[vardepvalue] = 'meta-openpli'

LICENSE_PATH += "${LAYERDIR}/licenses"

WARN_QA_remove += "ldflags build-deps already-stripped textrel incompatible-license staticdev patch-fuzz"
ERROR_QA_remove += "license-checksum file-rdeps dev-so debug-deps dev-deps debug-files"
HOSTTOOLS += "upx zip"
```
